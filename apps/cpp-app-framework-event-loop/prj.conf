## CMakeLists.txt
```
cmake_minimum_required(VERSION 3.20.0)

find_package(Zephyr REQUIRED HINTS $ENV{ZEPHYR_BASE})

project(my_zephyr_app)

set(CMAKE_EXPORT_COMPILE_COMMANDS ON)

Include(FetchContent)

FetchContent_Declare(
  etl
  GIT_REPOSITORY https://github.com/ETLCPP/etl
  GIT_TAG        20.39.4
)

FetchContent_MakeAvailable(etl)

target_sources(app PRIVATE src/main.cpp src/EventLoop.cpp src/Timer.cpp src/Led.cpp)
target_link_libraries(app PRIVATE etl::etl)
```

## prj.conf
```kconfig
CONFIG_CPP=y
CONFIG_COMMON_LIBC_MALLOC_ARENA_SIZE=128

CONFIG_REQUIRES_FULL_LIBCPP=y

CONFIG_HEAP_MEM_POOL_SIZE=1024

CONFIG_THREAD_MONITOR=y
CONFIG_THREAD_NAME=y

CONFIG_LOG=y
CONFIG_LOG_DEFAULT_LEVEL=3
CONFIG_LOG_MODE_IMMEDIATE=y

CONFIG_ASSERT=y

CONFIG_ZBUS=y
CONFIG_ZBUS_LOG_LEVEL_INF=y
CONFIG_ZBUS_CHANNEL_NAME=y
CONFIG_ZBUS_OBSERVER_NAME=y
CONFIG_ZBUS_RUNTIME_OBSERVERS=y
```

## src/main.cpp
```c
#include <stdio.h>
#include <functional>

#include <zephyr/kernel.h>
#include <zephyr/logging/log.h>

#include "Timer.hpp"
#include "Led.hpp"
#include "EventLoop.hpp"

LOG_MODULE_REGISTER(Main, LOG_LEVEL_DBG);

int main(void)
{
    EventLoop::createInstance();
    EventLoop * eventLoop = EventLoop::getInstance();

    // This could be called from an interrupt, to say, process a GPIO changing state
    eventLoop->executeInLoop([]() {
        LOG_INF("Running in event loop!");
    });

    Timer timer([]() {
        LOG_INF("1000ms timer expired!");
    });
    timer.start(1000);

    Timer timer2([]() {
        LOG_INF("2100ms timer expired!");
    });
    timer2.start(2100);

    Led led;
    led.flash(1000);

    // This won't return
    eventLoop->run();
}
```

## src/Constants.hpp
```c
#pragma once

#include <stdint.h>

//================================================================================================//
// CONSTANTS
//================================================================================================//

const uint8_t MAX_NUM_NESTED_STATES = 10;
const uint8_t MAX_MSG_SIZE_BYTES = 30;
const uint8_t MSG_QUEUE_SIZE = 10;
```

## src/Event.hpp
```c
#pragma once

#include <stdint.h>
#include <stddef.h>
#include <functional>


enum class EventId {
    RUN_IN_LOOP,
};

class EventBase {
public:
    EventId m_id;
    const char * m_name;

    EventBase(EventId id, const char * name) {
        this->m_id = id;
        this->m_name = name;
    }
};

class RunInLoopEvent : public EventBase {
public:
    std::function<void()> m_fn;

    RunInLoopEvent(std::function<void()> fn) : EventBase(EventId::RUN_IN_LOOP, "RunInLoopEvent") {
        this->m_fn = fn;
    }
};
```

## src/EventLoop.cpp
```c
#include <zephyr/kernel.h>
#include <zephyr/logging/log.h>

#include "Event.hpp"
#include "EventLoop.hpp"
#include "Constants.hpp"
#include "Timer.hpp"
#include "Led.hpp"

LOG_MODULE_REGISTER(EventLoop, LOG_LEVEL_DBG);

EventLoop * EventLoop::m_instance = nullptr;

void threadFnAdapter(void * p1, void * p2, void * p3) {
    EventLoop * eventLoop = static_cast<EventLoop*>(p1);
    eventLoop->run();
}

EventLoop::EventLoop() {
    LOG_DBG("EventLoop constructor");

    // Create message queue for receiving messages
    this->msgQueueBuffer = static_cast<char*>(k_malloc(MSG_QUEUE_SIZE * MAX_MSG_SIZE_BYTES));
    k_msgq_init(&msgQueue, msgQueueBuffer, MAX_MSG_SIZE_BYTES, MSG_QUEUE_SIZE);
}

void EventLoop::run() {
    LOG_DBG("EventLoop run()");

    while (true) {
        // Iterate through all registered timers, and find the one that is expiring next (if any)
        Timer * timerThatIsExpiringNext = nullptr;
        LOG_DBG("Iterating through timers. numTimers: %d", this->m_numTimers);
        for(uint32_t i = 0; i < this->m_numTimers; i++) {
            Timer * timer = this->m_timers[i];
            if (timer->isRunning()) {
                if (timerThatIsExpiringNext == nullptr || timer->nextExpiryTime_ticks < timerThatIsExpiringNext->nextExpiryTime_ticks) {
                    timerThatIsExpiringNext = timer;
                }
            }
        }

        // Convert the expiry time to a duration from now
        // Calculate time to wait for next timeout event
        k_timeout_t durationToWait = K_FOREVER;
        int64_t uptime_ticks = k_uptime_ticks();
        if (timerThatIsExpiringNext != nullptr) {
            LOG_DBG("Timer that is expiring next has nextExpiryTime_ticks: %" PRId64 ". uptime_ticks: %" PRId64, timerThatIsExpiringNext->nextExpiryTime_ticks, uptime_ticks);
            if (timerThatIsExpiringNext->nextExpiryTime_ticks <= uptime_ticks) {
                durationToWait = K_NO_WAIT;
                LOG_WRN("Timer already expired.");
            } else {
                durationToWait = K_TICKS(timerThatIsExpiringNext->nextExpiryTime_ticks - uptime_ticks);
            }
        }

        // Wait for events on message queue
        uint8_t data[MAX_MSG_SIZE_BYTES] = {0};
        int queueRc = k_msgq_get(&msgQueue, data, durationToWait);
        if (queueRc == 0) {
            // Convert to event
            EventBase * event = reinterpret_cast<EventBase*>(data);
            switch (event->m_id) {
                case EventId::RUN_IN_LOOP:
                    RunInLoopEvent * runInLoopEvent = reinterpret_cast<RunInLoopEvent*>(event);
                    runInLoopEvent->m_fn();
                    break;
            }
        }
        else {
            // This must mean that the timer expired!

            // This should never be nullptr, as we should have set it to a valid timer before blocking
            // on the message queue
            __ASSERT_NO_MSG(timerThatIsExpiringNext != nullptr);
            timerThatIsExpiringNext->expiryFn();
            // Update timer. This will either stop the timer if it is a one-shot, or update the next expiry time
            timerThatIsExpiringNext->updateAfterExpiry();
        }
    }
}

void EventLoop::postEvent(EventBase * event, uint8_t size) {
        // Make sure event is not bigger than message size
    // static_assert(sizeof(T) <= MSG_SIZE_BYTES, "Event size is too big for message queue");
    __ASSERT(size <= MAX_MSG_SIZE_BYTES, "Event size of %u is bigger than the max. event size of %u.", size, MAX_MSG_SIZE_BYTES);

    // Convert to char array
    uint8_t data[MAX_MSG_SIZE_BYTES] = {0};
    memcpy(data, event, size);
    k_msgq_put(&msgQueue, data, K_NO_WAIT);
}

void EventLoop::executeInLoop(std::function<void()> fn) {
    // Create a run in loop event
    RunInLoopEvent event(fn);
    this->postEvent(&event, sizeof(event));
}

void EventLoop::registerTimer(Timer * timer) {
    // Add to list of timers
    this->m_timers[this->m_numTimers] = timer;
    this->m_numTimers++;
}
```

## src/EventLoop.hpp
```c
#pragma once

#include <functional>

#include <zephyr/kernel.h>
#include <etl/array.h>

#include "Event.hpp"
#include "Timer.hpp"

class EventLoop {
public:
    
    /**
     * Call to run the event loop. Does not return.
     */
    void run();

    /**
     * Schedule a function to be run in the event loop.
     * 
     * This can be called from any thread or interrupt.
     */
    void executeInLoop(std::function<void()> fn);

    /**
     * Register a timer.
     * 
     * NOT THREAD SAFE. Must be called from the event loop thread.
     * 
     * @param timer The timer to register.
     */
    void registerTimer(Timer * timer);

    static void createInstance() {
        if (m_instance == nullptr) {
            m_instance = new EventLoop();
        }
    }

    static EventLoop * getInstance() {
        return m_instance;
    }

private:
    /**
     * Private constructor. Create instance through createInstance() instead.
     */
    EventLoop();

    void postEvent(EventBase * event, uint8_t size);

    char * msgQueueBuffer;
    struct k_msgq msgQueue;

    // etl::array<uint32_t, 10> array;

    Timer * m_timers[10];
    uint32_t m_numTimers = 0;

    /**
     * Expose a single instance of the event loop.  
     */
    static EventLoop * m_instance;

};
```

## src/Led.cpp
```c
#include <stdint.h>
#include <stdio.h>

#include <zephyr/logging/log.h>

#include "Led.hpp"

LOG_MODULE_REGISTER(Led, LOG_LEVEL_DBG);

Led::Led() : 
        m_timer([this]() { this->onTimerExpired(); }) {
}

void Led::on() {}
void Led::off() {}
void Led::flash(uint32_t ms) {
    m_timer.start(ms, ms);
}

void Led::onTimerExpired() {
    LOG_INF("LED flashing!");
}
```

## src/Led.hpp
```c
#pragma once

#include <stdint.h>
#include <stdio.h>

#include "Timer.hpp"

class Led {
public:
    Led();
    void on();
    void off();
    void flash(uint32_t ms);

private:
    Timer m_timer;

    void onTimerExpired();
};
```

## src/Timer.cpp
```c
#include <cstring>
#include <stdio.h>
#include <zephyr/kernel.h>
#include <zephyr/logging/log.h>

#include "Timer.hpp"
#include "EventLoop.hpp"
LOG_MODULE_REGISTER(Timer, LOG_LEVEL_DBG);

Timer::Timer(std::function<void ()> expiryFn) :
        period_ticks(0),
        startTime_ticks(0),
        nextExpiryTime_ticks(0),
        m_isRunning(false),
        m_expiryFn(expiryFn)
    {
        LOG_DBG("Function called.");

        // Register with event loop
        EventLoop * eventLoop = EventLoop::getInstance();
        eventLoop->registerTimer(this);
    }

void Timer::start(int64_t period_ms) {
    // Convert ms to ticks
    LOG_DBG("period_ms: %d", period_ms);
    start(period_ms, period_ms);
}

void Timer::start(int64_t startDuration_ms, int64_t period_ms)
{
    __ASSERT_NO_MSG(startDuration_ms >= 0); // Start time can be 0, which means the timer will fire immediately. Can't be negative!
    __ASSERT_NO_MSG(period_ms >= -1); // Period can be -1, which means the timer will not repeat
    LOG_DBG("startDuration_ms: %lld. period_ms: %lld", startDuration_ms, period_ms);
    this->startTime_ticks = k_uptime_ticks();
    LOG_DBG("startTime_ticks: %" PRId64, this->startTime_ticks);
    // Use ceil and not floor to guarantee a minimum delay
    LOG_DBG("k_ms_to_ticks_ceil64(startDuration_ms): %" PRId64, k_ms_to_ticks_ceil64(startDuration_ms));
    this->nextExpiryTime_ticks = this->startTime_ticks + k_ms_to_ticks_ceil64(startDuration_ms);
    LOG_DBG("startDuration_ms: %" PRId64 ". period_ms: %" PRId64 ". startTime_ticks: %" PRId64 ". nextExpiryTime_ticks: %" PRId64, startDuration_ms, period_ms, this->startTime_ticks, this->nextExpiryTime_ticks);
    if (period_ms == -1)
    {
        this->period_ticks = -1;
    }
    else
    {
        this->period_ticks = k_ms_to_ticks_ceil64(period_ms);
    }

    this->m_isRunning = true;
}

bool Timer::isRunning() {
    return this->m_isRunning;
}

void Timer::updateAfterExpiry() {
    if (this->period_ticks == -1)
    {
        // Timer was one-shot, so stop it
        this->m_isRunning = false;
    }
    else
    {
        // Update expiry time based on the period
        this->nextExpiryTime_ticks += this->period_ticks;
    }
}

void Timer::expiryFn() {
    if (this->m_expiryFn) {
        this->m_expiryFn();
    } else {
        LOG_WRN("No expiry function set.");
    }
}
```

## src/Timer.hpp
```c
#pragma once

//================================================================================================//
// FORWARD DECLARATIONS
//================================================================================================//

class Timer;

//================================================================================================//
// INCLUDES
//================================================================================================//

#include <stdint.h>
#include <functional>

//================================================================================================//
// CLASS DECLARATION
//================================================================================================//

class Timer {
public:
    int64_t period_ticks;
    int64_t startTime_ticks;
    int64_t nextExpiryTime_ticks;
    bool m_isRunning;
    bool m_beforeFirstExpiry;

    std::function<void ()> m_expiryFn;

    Timer(std::function<void ()> expiryFn);

    /**
     * Start the timer in reoccurring mode. The timer will expire for the first time
     * after period_ms from when this is called, and then period_ms after that.
    */
    void start(int64_t period_ms);

    /**
     * Start the timer in either one-shot or reoccurring mode.
     * 
     * @param startDuration_ms The time to wait before the first expiry. Must either be 0 (no-wait) or positive.
     * @param period_ms The period of the timer. Set to -1 for a one-shot timer, or 0/positive for a recurring timer.
    */
    void start(int64_t startDuration_ms, int64_t period_ms);

    /**
     * Check if the timer is running.
     * 
     * @return true if the timer is running, false otherwise.
    */
    bool isRunning();

    /**
     * Designed to be called by the state machine when the timer expires.
     * 
     * This will either:
     * 1. Stop the timer if it is a one-shot timer.
     * 2. Update the next expiry time if it is a recurring timer.
    */
    void updateAfterExpiry();

    void expiryFn();
};
```
