## CMakeLists.txt
```
cmake_minimum_required(VERSION 3.20.0)

find_package(Zephyr)
project(my_zephyr_app)

set(CMAKE_EXPORT_COMPILE_COMMANDS ON)

target_sources(app PRIVATE src/App.cpp)
target_sources(app PRIVATE src/main.cpp)
target_sources(app PRIVATE src/LedSm.cpp)
target_sources(app PRIVATE src/StateMachineLibrary/StateMachine.cpp)
target_sources(app PRIVATE src/StateMachineLibrary/StateMachineController.cpp)
target_sources(app PRIVATE src/StateMachineLibrary/Timer.cpp)
target_sources(app PRIVATE src/MasterSm.cpp)
target_sources(app PRIVATE src/SecondSm.cpp)
```

## prj.conf
```kconfig
CONFIG_CPP=y
CONFIG_COMMON_LIBC_MALLOC_ARENA_SIZE=128

CONFIG_REQUIRES_FULL_LIBCPP=y

CONFIG_HEAP_MEM_POOL_SIZE=1024

CONFIG_LOG=y
CONFIG_LOG_DEFAULT_LEVEL=3
CONFIG_LOG_MODE_IMMEDIATE=y

CONFIG_ASSERT=y

CONFIG_ZBUS=y
CONFIG_ZBUS_LOG_LEVEL_INF=y
CONFIG_ZBUS_CHANNEL_NAME=y
CONFIG_ZBUS_OBSERVER_NAME=y
CONFIG_ZBUS_RUNTIME_OBSERVERS=y
```

## src/main.cpp
```c
#include <stdio.h>
#include <functional>

#include <zephyr/kernel.h>
#include <zephyr/logging/log.h>
#include <zephyr/zbus/zbus.h>

#include "Led.h"
#include "MasterSm.hpp"
#include "StateMachine.h"
#include "StateMachineController.h"

LOG_MODULE_REGISTER(Main, LOG_LEVEL_DBG);

// MASTER SM
const uint32_t MASTER_THREAD_STACK_SIZE_B = 1024;
K_THREAD_STACK_DEFINE(masterThreadStack, MASTER_THREAD_STACK_SIZE_B);
MasterSm * l_masterSm = nullptr;
void masterThreadFnAdapter(void *, void *, void *) {
    l_masterSm->threadFn();
}

// LED SM
const uint32_t LED_THREAD_STACK_SIZE_B = 1024;
K_THREAD_STACK_DEFINE(ledThreadStack, LED_THREAD_STACK_SIZE_B);
Led * l_led = nullptr;
void ledThreadFnAdapter(void *, void *, void *) {
    l_led->threadFn();
}

int main(void)
{
    StateMachineController smc;

    auto masterSm = MasterSm(masterThreadStack,
                             MASTER_THREAD_STACK_SIZE_B,
                             &masterThreadFnAdapter,
                             &smc);
    l_masterSm = &masterSm;

    auto led = Led(ledThreadStack,
                   LED_THREAD_STACK_SIZE_B,
                   &ledThreadFnAdapter,
                   &smc,
                   "Led1Sm");
    l_led = &led;

    // Start all the state machines
    smc.startAll();

    k_msleep(1000);
    led.turnOn();

    k_msleep(1000);

    // Make the LED flash
    led.blink(5, 1000, 1000);


    // const struct zbus_channel *chan;

	// while (!zbus_sub_wait(&bar_sub, &chan, K_FOREVER)) {
	// 	struct acc_msg acc;

	// 	if (&acc_data_chan == chan) {
	// 		zbus_chan_read(&acc_data_chan, &acc, K_MSEC(500));

	// 		LOG_INF("From subscriber -> Acc x=%d, y=%d, z=%d", acc.x, acc.y, acc.z);
	// 	}
	// }
    
    LOG_DBG("Terminating thread\n");
    led.terminateThread();
    LOG_DBG("Joining thread\n");
    led.join();
    LOG_DBG("main() returning...\n");
}
```

## src/App.cpp
```c
#include <stdio.h>
#include <functional>

#include <zephyr/kernel.h>
#include <zephyr/logging/log.h>
#include <zephyr/zbus/zbus.h>

#include "App.hpp"
#include "MasterSm.hpp"

#include "StateMachineLibrary/StateMachineController.h"

LOG_MODULE_REGISTER(App, LOG_LEVEL_DBG);

// MASTER SM
const uint32_t MASTER_THREAD_STACK_SIZE_B = 1024;
K_THREAD_STACK_DEFINE(masterThreadStack, MASTER_THREAD_STACK_SIZE_B);
MasterSm * l_masterSm = nullptr;
void masterThreadFnAdapter(void *, void *, void *) {
    l_masterSm->threadFn();
}

// SECOND SM
const uint32_t SECOND_THREAD_STACK_SIZE_B = 1024;
K_THREAD_STACK_DEFINE(secondThreadStack, SECOND_THREAD_STACK_SIZE_B);
SecondSm * l_secondSm = nullptr;
void secondThreadFnAdapter(void *, void *, void *) {
    l_secondSm->threadFn();
}

// LED SM
const uint32_t LED_THREAD_STACK_SIZE_B = 1024;
K_THREAD_STACK_DEFINE(ledThreadStack, LED_THREAD_STACK_SIZE_B);
LedSm * l_led = nullptr;
void ledThreadFnAdapter(void *, void *, void *) {
    l_led->threadFn();
}

App::App()
    :
    m_smc(),
    m_masterSm(masterThreadStack,
                MASTER_THREAD_STACK_SIZE_B,
                &masterThreadFnAdapter,
                this),
    m_secondSm(secondThreadStack,
                SECOND_THREAD_STACK_SIZE_B,
                &secondThreadFnAdapter,
                this),
    m_ledSm(ledThreadStack,
            LED_THREAD_STACK_SIZE_B,
            &ledThreadFnAdapter,
            &m_smc,
            "Led1Sm")
{

    l_masterSm = &m_masterSm;
    l_secondSm = &m_secondSm;
    l_led = &m_ledSm;

    // Register the events

    LOG_INF("App created.");
}

void App::run(void)
{
    // Start all the state machines
    LOG_DBG("Starting all state machines...");
    m_smc.startAll();

    auto timeout = K_MSEC(1000);

    k_msleep(100*1000);
    // led.turnOn();

    // k_msleep(1000);

    // // Make the LED flash
    // led.blink(5, 1000, 1000);


    // const struct zbus_channel *chan;

	// while (!zbus_sub_wait(&bar_sub, &chan, K_FOREVER)) {
	// 	struct acc_msg acc;

	// 	if (&acc_data_chan == chan) {
	// 		zbus_chan_read(&acc_data_chan, &acc, K_MSEC(500));

	// 		LOG_INF("From subscriber -> Acc x=%d, y=%d, z=%d", acc.x, acc.y, acc.z);
	// 	}
	// }
    
    // LOG_DBG("Terminating thread\n");
    // led.terminateThread();
    // LOG_DBG("Joining thread\n");
    // led.join();
    // LOG_DBG("main() returning...\n");
}
```

## src/App.hpp
```c
#pragma once

class App;

#include "StateMachineLibrary/StateMachineController.hpp"
#include "LedSm.hpp"
#include "MasterSm.hpp"
#include "SecondSm.hpp"

class App
{
public:
    App();
    void run();

    StateMachineController * getSmc() { return &m_smc; }

    MasterSm * getMasterSm() { return &m_masterSm; }
    SecondSm * getSecondSm() { return &m_secondSm; }
    LedSm * getLedSm() { return &m_ledSm; }

private:
    StateMachineController m_smc;

    MasterSm m_masterSm;
    SecondSm m_secondSm;
    LedSm m_ledSm;
};
```

## src/Led.cpp
```c
#include <cstdio>

#include <zephyr/logging/log.h>

#include "Led.h"

LOG_MODULE_REGISTER(Led, LOG_LEVEL_DBG);

const uint8_t MAX_NUM_STATES = 10;

Led::Led(z_thread_stack_element * threadStack,
         uint32_t threadStackSize_B,
         void (*threadFnAdapter)(void *, void *, void *),
         StateMachineController * smc,
         const char * name)
    :
        StateMachine(MAX_NUM_STATES, threadStack, threadStackSize_B, threadFnAdapter, smc, name),
        root(
            std::bind(&Led::Root_Entry, this),
            std::bind(&Led::Root_Event, this, std::placeholders::_1),
            std::bind(&Led::Root_Exit, this),
            nullptr, "Root"),
        off(
            std::bind(&Led::Off_Entry, this),
            std::bind(&Led::Off_Event, this, std::placeholders::_1),
            std::bind(&Led::Off_Exit, this),
            &root, "Off"),
        on(
            std::bind(&Led::On_Entry, this),
            std::bind(&Led::On_Event, this, std::placeholders::_1),
            std::bind(&Led::On_Exit, this),
            &root, "On")
{
    LOG_INF("Led created\n");

    // Register events
    // auto eventId = EventId("BlinkEvent");
    blinkEventId = smc->registerEvent();


    addState(&off);
    addTimer(&timer);

    // Setup initial transition
    initialTransition(&off);
}

void Led::turnOn() {
    LOG_INF("%s called", __PRETTY_FUNCTION__);

    // Send event to state machine
    auto event = Event((uint8_t)LedEventId::ON);
    sendEvent2(&event, sizeof(event));
}

void Led::blink(uint8_t numTimes, uint32_t onTime_ms, uint32_t offTime_ms)
{
    LOG_INF("%s called", __PRETTY_FUNCTION__);

    // char data[10];
    // BlinkEvent * event = reinterpret_cast<BlinkEvent*>(data);
    // event->id = (uint8_t)LedEventId::BLINK;
    // event->numTimes = numTimes;
    // event->onTime_ms = onTime_ms;
    // event->offTime_ms = offTime_ms;

    BlinkEvent event(numTimes, onTime_ms, offTime_ms);

    // Send event to state machine
    // k_msgq_put(&msgQueue, &data, K_NO_WAIT);
    // auto event1 = Event(event);
    sendEvent2(&event, sizeof(event));
    // smc->sendEvent(blinkEventId, &event, sizeof(event));
}

//============================================================
// STATE: Root
//============================================================

void Led::Root_Entry() {
    LOG_INF("%s called", __PRETTY_FUNCTION__);
}

void Led::Root_Event(Event* event) {
    LOG_INF("%s called. event.id: %u.", __PRETTY_FUNCTION__, event->id);

    if (event->id == (uint8_t)LedEventId::BLINK) {
        // Got blink event. Reinterp cast to BlinkEvent
        auto blinkEvent = reinterpret_cast<BlinkEvent*>(event);

        LOG_DBG("Got blink event. numTimes: %u, onTime_ms: %u, offTime_ms: %u", blinkEvent->numTimes, blinkEvent->onTime_ms, blinkEvent->offTime_ms);
        
        return;
    }

    return;
}

void Led::Root_Exit() {
    LOG_INF("%s called", __PRETTY_FUNCTION__);
}

//============================================================
// STATE: Root/Off
//============================================================

void Led::Off_Entry() {
    LOG_INF("%s called", __PRETTY_FUNCTION__);
}

void Led::Off_Event(Event* event) {
    LOG_INF("%s called. event.id: %u.", __PRETTY_FUNCTION__, event->id);

    if (event->id == (uint8_t)LedEventId::ON) {
        // Transition to On state
        queueTransition(&on);
        return;
    }
    return;
}

void Led::Off_Exit() {
    LOG_INF("%s called", __PRETTY_FUNCTION__);
}

//============================================================
// STATE: Root/On
//============================================================

void Led::On_Entry() {
    LOG_INF("%s called", __PRETTY_FUNCTION__);

    // Start timer
    Event event;
    event.id = (uint8_t)LedEventId::TIMER_EXPIRED;
    timer.start(k_ms_to_ticks_floor64(5*1000), event);
}

void Led::On_Event(Event * event) {
    LOG_INF("%s called. event.id: %u.", __PRETTY_FUNCTION__, event->id);
    return;
}

void Led::On_Exit() {
    LOG_INF("%s called", __PRETTY_FUNCTION__);
}
```

## src/Led.h
```c
#pragma once

#include <cstring>

#include <zephyr/kernel.h>

#include "StateMachineLibrary/StateMachine.h"

enum class LedEventId {
    ON = (uint8_t)EventId::MAX_VALUE,
    OFF,
    TIMER_EXPIRED,
    BLINK,
    MAX_VALUE,
};

#pragma pack(push, 1)
class BlinkEvent : public Event {
public:
    uint8_t numTimes;
    uint32_t onTime_ms;
    uint32_t offTime_ms;


    BlinkEvent(uint8_t numTimes, uint32_t onTime_ms, uint32_t offTime_ms)
        :
        Event((uint8_t)LedEventId::BLINK), 
        numTimes(numTimes),
        onTime_ms(onTime_ms),
        offTime_ms(offTime_ms)
    {
    }
};
#pragma pack(pop)

class Led: public StateMachine {
    public:
        Led(
            z_thread_stack_element * threadStack,
            uint32_t threadStackSize_B,
            void (*threadFnAdapter)(void *, void *, void *),
            StateMachineController * smc,
            const char * name);

        void turnOn();

        void blink(uint8_t numTimes, uint32_t onTime_ms, uint32_t offTime_ms);

    private:

        uint8_t blinkEventId;


        State root;
        void Root_Entry();
        void Root_Event(Event* event);
        void Root_Exit();

        State off;
        void Off_Entry();
        void Off_Event(Event* event);
        void Off_Exit();

        State on;
        void On_Entry();
        void On_Event(Event* event);
        void On_Exit();

        Timer timer;
};
```

## src/LedSm.cpp
```c
#include <cstdio>

#include <zephyr/logging/log.h>

#include "LedSm.hpp"

LOG_MODULE_REGISTER(LedSm, LOG_LEVEL_DBG);

const uint8_t MAX_NUM_STATES = 10;

LedSm::LedSm(z_thread_stack_element * threadStack,
         uint32_t threadStackSize_B,
         void (*threadFnAdapter)(void *, void *, void *),
         StateMachineController * smc,
         const char * name)
    :
        StateMachine(MAX_NUM_STATES, threadStack, threadStackSize_B, threadFnAdapter, smc, name),
        root(
            std::bind(&LedSm::Root_Entry, this),
            std::bind(&LedSm::Root_Event, this, std::placeholders::_1),
            std::bind(&LedSm::Root_Exit, this),
            nullptr, "Root"),
        off(
            std::bind(&LedSm::Off_Entry, this),
            std::bind(&LedSm::Off_Event, this, std::placeholders::_1),
            std::bind(&LedSm::Off_Exit, this),
            &root, "Off"),
        on(
            std::bind(&LedSm::On_Entry, this),
            std::bind(&LedSm::On_Event, this, std::placeholders::_1),
            std::bind(&LedSm::On_Exit, this),
            &root, "On")
{
    LOG_DBG("Led created\n");

    addState(&off);
    registerTimer(&timer);

    // Setup initial transition
    setInitialTransition(&off);
}

void LedSm::turnOn() {
    LOG_INF("%s called", __PRETTY_FUNCTION__);

    // Send event to state machine
    auto event = OnEvent();
    sendEvent(&event, sizeof(event));
}

void LedSm::blink(uint8_t numTimes, uint32_t onTime_ms, uint32_t offTime_ms)
{
    LOG_INF("%s called", __PRETTY_FUNCTION__);
    BlinkEvent event(numTimes, onTime_ms, offTime_ms);

    // Send event to state machine
    sendEvent(&event, sizeof(event));
}

//============================================================
// STATE: Root
//============================================================

void LedSm::Root_Entry() {
    LOG_DBG("%s called", __PRETTY_FUNCTION__);
}

void LedSm::Root_Event(Event* event) {
    LOG_DBG("%s called. event.id: %u.", __PRETTY_FUNCTION__, event->id);

    if (event->id == (uint8_t)TypeID::value<BlinkEvent>()) {
        // Got blink event. Reinterp cast to BlinkEvent
        auto blinkEvent = reinterpret_cast<BlinkEvent*>(event);

        LOG_DBG("Got blink event. numTimes: %u, onTime_ms: %u, offTime_ms: %u", blinkEvent->numTimes, blinkEvent->onTime_ms, blinkEvent->offTime_ms);
        
        return;
    }

    return;
}

void LedSm::Root_Exit() {
    LOG_DBG("%s called", __PRETTY_FUNCTION__);
}

//============================================================
// STATE: Root/Off
//============================================================

void LedSm::Off_Entry() {
    LOG_DBG("%s called", __PRETTY_FUNCTION__);
}

void LedSm::Off_Event(Event* event) {
    LOG_DBG("%s called. event.id: %u.", __PRETTY_FUNCTION__, event->id);

    if (event->id == (uint8_t)TypeID::value<OnEvent>()) {
        // Transition to On state
        queueTransition(&on);
        return;
    }
    return;
}

void LedSm::Off_Exit() {
    LOG_DBG("%s called", __PRETTY_FUNCTION__);
}

//============================================================
// STATE: Root/On
//============================================================

void LedSm::On_Entry() {
    LOG_DBG("%s called", __PRETTY_FUNCTION__);

    // Start timer
    TimerExpiryEvent event;
    timer.start(k_ms_to_ticks_floor64(5*1000), &event, sizeof(event));
}

void LedSm::On_Event(Event * event) {
    LOG_DBG("%s called. event.id: %u.", __PRETTY_FUNCTION__, event->id);
    if (event->id == (uint8_t)TypeID::value<TimerExpiryEvent>()) {
        // Timer expired
        LOG_DBG("Timer expired.");
        queueTransition(&off);
        return;
    }
    return;
}

void LedSm::On_Exit() {
    LOG_DBG("%s called", __PRETTY_FUNCTION__);
}
```

## src/LedSm.hpp
```c
#pragma once

#include <cstring>

#include <zephyr/kernel.h>

#include "StateMachineLibrary/StateMachine.hpp"

//================================================================================================//
// EVENTS
//================================================================================================//

#pragma pack(push, 1)
class OnEvent : public Event {
public:
    OnEvent() : Event(EventId::value<OnEvent>(), "LedSm::OnEvent")
    {
        // nothing to do
    }
};

class BlinkEvent : public Event {
public:
    uint8_t numTimes;
    uint32_t onTime_ms;
    uint32_t offTime_ms;

    BlinkEvent(uint8_t numTimes, uint32_t onTime_ms, uint32_t offTime_ms)
        :
        Event(EventId::value<BlinkEvent>(), "LedSm::BlinkEvent"),
        numTimes(numTimes),
        onTime_ms(onTime_ms),
        offTime_ms(offTime_ms)
    {
    }
};

class TimerExpiryEvent : public Event {
public:
    TimerExpiryEvent() : Event(EventId::value<TimerExpiryEvent>(), "LedSm::TimerExpiryEvent")
    {
        // nothing to do
    }
};
#pragma pack(pop)

//================================================================================================//
// STATE MACHINE
//================================================================================================//

class LedSm: public StateMachine {
    public:
        LedSm(
            z_thread_stack_element * threadStack,
            uint32_t threadStackSize_B,
            void (*threadFnAdapter)(void *, void *, void *),
            StateMachineController * smc,
            const char * name);

        void turnOn();

        void blink(uint8_t numTimes, uint32_t onTime_ms, uint32_t offTime_ms);


    private:

        State root;
        void Root_Entry();
        void Root_Event(Event* event);
        void Root_Exit();

        State off;
        void Off_Entry();
        void Off_Event(Event* event);
        void Off_Exit();

        State on;
        void On_Entry();
        void On_Event(Event* event);
        void On_Exit();

        Timer timer;
};
```

## src/MasterSm.cpp
```c
#include <zephyr/logging/log.h>

#include "App.hpp"
#include "MasterSm.hpp"
#include "SecondSm.hpp"

LOG_MODULE_REGISTER(MasterSm, LOG_LEVEL_DBG);

//================================================================================================//
// FILE SCOPE EVENTS
//================================================================================================//

#pragma pack(push, 1)
class Timer1ExpiryEvent : public Event {
public:
    Timer1ExpiryEvent() 
        :
        Event(TypeID::value<Timer1ExpiryEvent>(), "MasterSm::Timer1ExpiryEvent")
    {
        // nothing to do
    }
};

class Timer2ExpiryEvent : public Event {
public:
    Timer2ExpiryEvent() 
        :
        Event(TypeID::value<Timer2ExpiryEvent>(), "MasterSm::Timer2ExpiryEvent")
    {
        // nothing to do
    }
};
#pragma pack(pop)

//================================================================================================//
// STATE MACHINE DEFINITION
//================================================================================================//

MasterSm::MasterSm(z_thread_stack_element * threadStack,
                   uint32_t threadStackSize_B,
                   void (*threadFnAdapter)(void *, void *, void *),
                   App * app)
    :
        StateMachine(10, threadStack, threadStackSize_B, threadFnAdapter, app->getSmc(), "MasterSm"),
        app(app),
        root(
            std::bind(&MasterSm::Root_Entry, this),
            std::bind(&MasterSm::Root_Event, this, std::placeholders::_1),
            std::bind(&MasterSm::Root_Exit, this),
            nullptr, "Root"),
        childStateA(
            std::bind(&MasterSm::ChildStateA_Entry, this),
            std::bind(&MasterSm::ChildStateA_Event, this, std::placeholders::_1),
            std::bind(&MasterSm::ChildStateA_Exit, this),
            &root, "ChildStateA"),
        childStateB(
            std::bind(&MasterSm::ChildStateB_Entry, this),
            std::bind(&MasterSm::ChildStateB_Event, this, std::placeholders::_1),
            std::bind(&MasterSm::ChildStateB_Exit, this),
            &root, "ChildStateB")
{
    LOG_INF("Master SM created.");

    // Register timers
    registerTimer(&timer1);
    registerTimer(&timer2);

    setInitialTransition(&root);
}

//============================================================
// STATE: Root
//============================================================

void MasterSm::Root_Entry() {
    LOG_INF("Root_Entry");

    // Start 2 timers
    Timer1ExpiryEvent timer1ExpiryEvent;
    timer1.start(3*1000, -1, &timer1ExpiryEvent, sizeof(timer1ExpiryEvent));

    Timer2ExpiryEvent timer2ExpiryEvent;
    timer2.start(6*1000, -1, &timer2ExpiryEvent, sizeof(timer2ExpiryEvent));


}

void MasterSm::Root_Event(Event* event) {
    LOG_INF("Root_Event");

    if (event->id == (uint8_t)TypeID::value<Timer1ExpiryEvent>()) {
        LOG_INF("timer1 expired.");
        queueTransition(&childStateA);
    } else if (event->id == (uint8_t)TypeID::value<Timer2ExpiryEvent>()) {
        LOG_INF("timer2 expired.");
        queueTransition(&childStateB);
    }
}

void MasterSm::Root_Exit() {
    LOG_INF("Root_Exit");
}

//============================================================
// STATE: Root/ChildStateA
//============================================================

void MasterSm::ChildStateA_Entry() {
    LOG_INF("%s called.", __PRETTY_FUNCTION__);
}

void MasterSm::ChildStateA_Event(Event* event) {
    LOG_INF("%s called. event.id: %u.", __PRETTY_FUNCTION__, event->id);
}

void MasterSm::ChildStateA_Exit() {
    LOG_INF("%s called.", __PRETTY_FUNCTION__);
}

//============================================================
// STATE: Root/ChildStateB
//============================================================

void MasterSm::ChildStateB_Entry() {
    LOG_INF("%s called.", __PRETTY_FUNCTION__);
}

void MasterSm::ChildStateB_Event(Event* event) {
    LOG_INF("%s called. event.id: %u.", __PRETTY_FUNCTION__, event->id);
}

void MasterSm::ChildStateB_Exit() {
    LOG_INF("%s called.", __PRETTY_FUNCTION__);
}
```

## src/MasterSm.hpp
```c
#pragma once

#include "StateMachineLibrary/StateMachine.h"

#include "App.hpp"

class MasterSm : public StateMachine {
public:
    MasterSm(
        z_thread_stack_element * threadStack,
        uint32_t threadStackSize_B,
        void (*threadFnAdapter)(void *, void *, void *),
        App * app);

private:
    App * app;
    State root;
    void Root_Entry();
    void Root_Event(Event* event);
    void Root_Exit();

    Timer timer1;
    Timer timer2;
};
```

## src/SecondSm.cpp
```c
#include <zephyr/logging/log.h>

#include "App.hpp"
#include "SecondSm.hpp"

LOG_MODULE_REGISTER(SecondSm, LOG_LEVEL_DBG);

SecondSm::SecondSm(z_thread_stack_element * threadStack,
                   uint32_t threadStackSize_B,
                   void (*threadFnAdapter)(void *, void *, void *),
                   App * app)
    :
        StateMachine(10, threadStack, threadStackSize_B, threadFnAdapter, app->getSmc(), "SecondSm"),
        app(app),
        root(
            std::bind(&SecondSm::Root_Entry, this),
            std::bind(&SecondSm::Root_Event, this, std::placeholders::_1),
            std::bind(&SecondSm::Root_Exit, this),
            nullptr, "Root")
{
    LOG_INF("SecondSM created.");

    initialTransition(&root);
}

//============================================================
// STATE: Root
//============================================================

void SecondSm::Root_Entry() {
    LOG_INF("Root_Entry");

    // Start LED flashing
    // app->getLedSm()->blink(5, 100, 100);
}

void SecondSm::Root_Event(Event* event) {
    LOG_INF("Root_Event");
}

void SecondSm::Root_Exit() {
    LOG_INF("Root_Exit");
}
```

## src/SecondSm.hpp
```c
#pragma once

#include "StateMachineLibrary/StateMachine.hpp"

#include "App.hpp"

class PrintHelloEvent : public Event {
public:
    uint8_t someData;
    PrintHelloEvent() : Event(EventId::value<PrintHelloEvent>(), "SecondSm::PrintHelloEvent")
    {
        someData = 0;
    }
};

class SecondSm : public StateMachine {
public:
    uint8_t helloEventId;
    SecondSm(
        z_thread_stack_element * threadStack,
        uint32_t threadStackSize_B,
        void (*threadFnAdapter)(void *, void *, void *),
        App * app);

private:
    App * app;
    State root;
    void Root_Entry();
    void Root_Event(Event* event);
    void Root_Exit();
};
```

## src/StateMachine.cpp
```c
#include <zephyr/kernel.h>
#include <zephyr/logging/log.h>

#include "StateMachine.h"

LOG_MODULE_REGISTER(StateMachine, LOG_LEVEL_DBG);

//===========================================================================//
// PUBLIC METHOD DEFINITIONS
//===========================================================================//

StateMachine::StateMachine(
    uint8_t maxNumStates,
    z_thread_stack_element * threadStack,
    uint32_t threadStackSize_B,
    void (*threadFnAdapter)(void *, void *, void *),
    StateMachineController * smc) :
        m_smc(smc),
        m_numStates(0),
        m_maxNumStates(maxNumStates),
        states(nullptr),
        m_currentState(nullptr), // Start off with no current state
        m_nextState(nullptr),
        timer(nullptr)
{
    LOG_DBG("Creating state machine...");
    this->states = static_cast<State**>(k_malloc(this->m_maxNumStates * sizeof(State*)));

    // Create message queue for receiving messages
    this->msgQueueBuffer = static_cast<char*>(k_malloc(MSG_QUEUE_SIZE * MAX_MSG_SIZE_BYTES));
    k_msgq_init(&msgQueue, msgQueueBuffer, MAX_MSG_SIZE_BYTES, MSG_QUEUE_SIZE);

    // Initialize SM mutex
    int rc = k_mutex_init(&mutex);
    __ASSERT_NO_MSG(rc == 0);

    this->threadStack = threadStack;
    k_tid_t my_tid = k_thread_create(&this->thread, this->threadStack,
                                    threadStackSize_B,
                                    threadFnAdapter,
                                    NULL, NULL, NULL,
                                    5, 0,
                                    K_FOREVER); // Don't start the thread yet

    printf("StateMachine created\n");
}

void StateMachine::initialTransition(State * state) {
    this->m_nextState = state;
}

void StateMachine::start() {
    LOG_DBG("Starting state machine thread...");
    k_thread_start(&this->thread);
}

void StateMachine::terminateThread() {
    auto event = Event((uint8_t)EventId::TERMINATE_THREAD);
    sendEvent(event);
}

void StateMachine::join() {
    LOG_DBG("Blocking until state machine thread terminates...");
    k_thread_join(&this->thread, K_FOREVER);
}

void StateMachine::addState(State * state) {
    __ASSERT(this->m_numStates < this->m_maxNumStates, "Exceeded max number of states of %u when trying to add state \"\".", this->m_maxNumStates, state->name ? state->name : "unknown");
    LOG_DBG("Adding state \"%s\" to state machine...", state->name);
    this->states[this->m_numStates] = state;
    this->m_numStates++;
}

void StateMachine::threadFn()  {
    LOG_DBG("Thread function for SM started...");

    // Lock mutex, this will be unlocked just before we block on the message queue
    k_mutex_lock(&mutex, K_FOREVER);

    // Perform initial transition from no current state to the initial state as
    // stored in m_nextState.
    LOG_DBG("Test1");
    LOG_DBG("this: %p", this);
    __ASSERT(this->m_nextState != nullptr, "No initial state set for state machine.");
    LOG_DBG("Test3");
    LOG_DBG("Calling entry functions for initial state %s...", this->m_nextState->name);
    executeTransition(this->m_nextState);

    while (1) {

        // k_msleep(1000);

        // Calculate time to wait for next timeout event
        k_timeout_t timeToWait = K_FOREVER;
        if (this->timer != nullptr && this->timer->isRunning()) {
            int64_t timeToWait_ticks = this->timer->timeToNextFire_ticks - k_uptime_ticks();
            if (timeToWait_ticks < 0) {
                timeToWait = K_NO_WAIT;
                LOG_DBG("Timer already expired.");
            } else {
                timeToWait = K_TICKS(timeToWait_ticks);
                LOG_DBG("Time to wait in ticks: %lld.", timeToWait_ticks);
            }
        } else {
            LOG_DBG("No timer set, waiting forever for message.");
        }

        // Just about to block on message queue, so unlock SM mutex
        k_mutex_unlock(&mutex);

        // Block on message queue, providing the correct timeout so that if
        // an event is not received, we handle the next timer timeout at the correct
        // time.
        // TODO: Change hardcoded 10 to constant
        char data[MAX_MSG_SIZE_BYTES];
        int queueRc = k_msgq_get(&msgQueue, &data, timeToWait);

        // Lock SM mutex until we get to the top of the loop again
        k_mutex_lock(&mutex, K_FOREVER);

        Event * event = reinterpret_cast<Event*>(&data);

        if (queueRc == 0) {
            LOG_DBG("SM thread received event.");
            if (event->id == (uint8_t)EventId::TERMINATE_THREAD) {
                LOG_DBG("Terminate thread event received. Returning from the thread function...");
                return;
            }
            processEvent(event);
        } else {
            LOG_DBG("SM timer expired.");
            processEvent(&this->timer->event);
            // Update timer
            this->timer->incrementNextFireTime();
        }
        if (m_terminateThread) {
            // This will return from the thread function, which terminates it.
            LOG_DBG("Returning from thread function...");
            return;
        }
        
    }
}

State * StateMachine::currentState()
{
    // Lock mutex
    k_mutex_lock(&mutex, K_FOREVER);
    // Get current state
    State * currentState = this->m_currentState;
    // Unlock mutex
    k_mutex_unlock(&mutex);
    return currentState;
}

void StateMachine::sendEvent2(void * event, uint8_t size)  {
    // Make sure event is not bigger than message size
    // static_assert(sizeof(T) <= MSG_SIZE_BYTES, "Event size is too big for message queue");
    __ASSERT(size <= MAX_MSG_SIZE_BYTES, "Event size of %u is bigger than the max. event size of %u.", size, MAX_MSG_SIZE_BYTES);

    // Convert to char array
    uint8_t data[MAX_MSG_SIZE_BYTES] = {0};
    memcpy(data, event, size);

    // Log the data we are about to put on the queue
    // Print each byte as hex
    LOG_DBG("Sending event to SM: ");
    for (int i = 0; i < MAX_MSG_SIZE_BYTES; i++) {
        // data[i] = -2;
        LOG_DBG("0x%02X", data[i]);
    }

    k_msgq_put(&msgQueue, data, K_NO_WAIT);
}

//===========================================================================//
// PRIVATE METHOD DEFINITIONS
//===========================================================================//

void StateMachine::processEvent(Event* event)  {
    // Loop through states from current state to root, calling event functions.
    // If at any point an event function requests a transition or to stop propagation,
    // we should break out of the loop.
    State * stateToProcess = this->m_currentState;
    while (stateToProcess != nullptr) {
        // Reset variables which might get changed when event functions are called
        m_terminateThread = false;
        m_nextState = nullptr;
        m_stopPropagation = false;
        stateToProcess->eventFn(event);
        if (m_terminateThread) {
            LOG_DBG("Terminate thread requested.");
            return;
        }
        if (m_nextState != nullptr) {
            executeTransition(m_nextState);
            return;
        }
        if (m_stopPropagation) {
            // Event function requested to stop propagation,
            // so bail from loop
            return;
        }
        stateToProcess = stateToProcess->parent;
    }
}

void StateMachine::executeTransition(State * nextState) {
    // We need to find the common parent of the current state and the
    // next state.
    State * commonParentState = this->m_currentState;
    // State<T> * m_nextState = this->m_nextState;
    while (commonParentState != nullptr) {
        State * parentState = nextState;
        while (parentState != nullptr) {
            if (commonParentState == parentState) {
                break;
            }
            parentState = parentState->parent;
        }
        if (parentState != nullptr) {
            break;
        }
        commonParentState = commonParentState->parent;
    }

    // At this point commonParentState should either point to the
    // common parent, or be nullptr, which means there was no
    // common parent
    LOG_DBG("Found common parent state: %s.", commonParentState ? commonParentState->name : "nullptr");

    // Now call the exit functions from child to common parent
    State * currentState = this->m_currentState;
    while (currentState != commonParentState) {
        currentState->exitFn();
        currentState = currentState->parent;
    }

    // Now call the entry functions from one below common parent (common parent is not exited/entered) to child,
    // first we need to build up a stack
    std::array<State*, MAX_NUM_NESTED_STATES> entryStateStack;
    currentState = nextState;
    int stackIndex = 0;
    while (currentState != commonParentState) {
        entryStateStack[stackIndex++] = currentState;
        currentState = currentState->parent;
        // Make sure we don't exceed the make number of nested states
        __ASSERT_NO_MSG(stackIndex < MAX_NUM_NESTED_STATES);
    }

    // Now we have stack, we can call entry functions in order
    for (int i = stackIndex - 1; i >= 0; i--) {
        entryStateStack[i]->entryFn();
    }

    // Finally, update the current state
    this->m_currentState = nextState;
}
```

## src/StateMachine.h
```c
#pragma once

class StateMachine;
class Event;

#include <functional>

#include <zephyr/kernel.h>
#include <zephyr/logging/log.h>



#include "StateMachineController.h"

const uint8_t MAX_NUM_NESTED_STATES = 10;

const uint8_t MAX_MSG_SIZE_BYTES = 20;
const uint8_t MSG_QUEUE_SIZE = 10;

enum class EventId {
    TERMINATE_THREAD,
    MAX_VALUE,
};

class Event {
public:
    uint8_t id;
    // uint8_t data[10];

    Event() {
        this->id = 0;
        // memset(this->data, 0, 10);
    }

    Event(uint8_t id) {
        this->id = id;
    }
};

class Timer {
public:
    int64_t period_ticks;
    int64_t startTime_ticks;
    int64_t timeToNextFire_ticks;
    bool m_isRunning;
    Event event;

    Timer() :
        period_ticks(0),
        startTime_ticks(0),
        timeToNextFire_ticks(0),
        m_isRunning(false)
    {
        // nothing to do
    }

    void start(int64_t period_ticks, Event event) {
        // Start timer
        this->period_ticks = period_ticks;
        this->event = event;

        // Save current time to work out when next to fire
        this->startTime_ticks = k_uptime_ticks();

        this->timeToNextFire_ticks = this->startTime_ticks + this->period_ticks;

        this->m_isRunning = true;
    }

    bool isRunning() {
        return this->m_isRunning;
    }

    void incrementNextFireTime() {
        this->timeToNextFire_ticks += this->period_ticks;
    }
};

class State {
public:
    State(
        std::function<void()> entryFn,
        std::function<void(Event*)> eventFn,
        std::function<void()> exitFn,
        State * parent = nullptr,
        const char * name = "<unknown>") :
        entryFn(entryFn),
        eventFn(eventFn),
        exitFn(exitFn),
        parent(parent),
        name(name)
    {
        // nothing to do
    }

    std::function<void()> entryFn;
    std::function<void(Event*)> eventFn;
    std::function<void()> exitFn;

    State * parent;
    const char * name;
};

class StateMachine {

public:

    struct k_mutex mutex;

    StateMachine(
        uint8_t maxNumStates,
        z_thread_stack_element * threadStack,
        uint32_t threadStackSize_B,
        void (*threadFnAdapter)(void *, void *, void *),
        StateMachineController * smc,
        const char * name);

    /**
     * @brief Add a state to the state machine.
     * State transitions will still work without adding the state to the state machine.
     * 
     * @param state Pointer to the state to add.
     * State must remain in scope for the lifetime of the state machine.
    */
    void addState(State * state);

    void addTimer(Timer * timer) {
        this->timer = timer;
    }

    void initialTransition(State * state);

    // Start the state machine thread.
    void start();

    void terminateThread();

    // Blocks until the state machine thread has terminated.
    void join();

    //! @brief The function to run in the context of the SM thread.
    //! The only reason this is public is because it needs to be called from a C 
    //! "adapter" function.
    //! This function does not return until the state machine is terminated.
    void threadFn();

    //! @brief Get the current state of the state machine. Will block while the state machine is busy.
    //! THREAD-SAFE
    //! @return Pointer to the current state.
    State * currentState();

    void sendEvent(Event &event)  {
        k_msgq_put(&msgQueue, &event, K_NO_WAIT);
    }

    void sendEvent2(void * event, uint8_t size);

    void queueTransition(State * state)  {
        // Save state to transition to
        this->m_nextState = state;
    }

    void stopPropagation()  {
        // Do nothing
        this->m_stopPropagation = true;
    }

    void terminateThreadSm()  {
        this->m_terminateThread = true;
    }

    const char * getName() {
        return this->m_name;
    }

private:

    StateMachineController * m_smc;
    const char * m_name;

    uint8_t m_numStates;
    uint8_t m_maxNumStates;
    State ** states;
    State * m_currentState;

    // Variables that can be set in state functions
    State * m_nextState;
    bool m_stopPropagation;
    bool m_terminateThread;

    char * msgQueueBuffer;
    struct k_msgq msgQueue;

    z_thread_stack_element * threadStack;
    struct k_thread thread;

    Timer * timer;


    //! Processes an event that has been received on the message queue.
    void processEvent(Event* event);

    void executeTransition(State * nextState);

};
```
