## CMakeLists.txt
```
cmake_minimum_required(VERSION 3.20.0)
find_package(Zephyr REQUIRED HINTS $ENV{ZEPHYR_BASE})
project(integration)

set(CMAKE_EXPORT_COMPILE_COMMANDS ON)

# Include all source files in the main application
# except main.c, which we will filter out
FILE(GLOB appSources ../src/*.cpp)
list(FILTER appSources EXCLUDE REGEX ".*main\\.cpp$")

# Include all source files in the test application
FILE(GLOB testAppSources src/*.cpp)
target_sources(app PRIVATE ${testAppSources} ${appSources})

# Add the main application directory to the include path
target_include_directories(app PRIVATE "../src/")
```

## prj.conf
```kconfig
CONFIG_ZTEST=y
CONFIG_GPIO=y

CONFIG_CPP=y
# CONFIG_COMMON_LIBC_MALLOC_ARENA_SIZE=128

CONFIG_REQUIRES_FULL_LIBCPP=y

CONFIG_HEAP_MEM_POOL_SIZE=1024

CONFIG_LOG=y
CONFIG_LOG_DEFAULT_LEVEL=3
CONFIG_LOG_MODE_IMMEDIATE=y

CONFIG_ASSERT=y
```

## src/main.cpp
```c
#include <zephyr/ztest.h>

#include "StateMachineLibrary/StateMachine.hpp"

#include "TestSm.h"

ZTEST_SUITE(framework_tests, NULL, NULL, NULL, NULL, NULL);


K_THREAD_STACK_DEFINE(smThreadStack, 2048);

TestSm * l_testSm = nullptr;

void smThreadFnAdapter(void *, void *, void *)
{
    l_testSm->threadFn();
}

void checkCallstack(
    TestSm * sm,
    std::array<const char *, CALL_STACK_DEPTH> &expectedCallStack)
{
    auto actualCallstack = sm->getCallstackAndClear();

    for (uint8_t i = 0; i < CALL_STACK_DEPTH; i++)
    {
        if (expectedCallStack[i] == nullptr)
        {
            // Reached end of call stack. Check the same index in
            // the actual callstack is nullptr also, then return
            zassert_is_null(actualCallstack[i], "Actual callstack has more entries than the expected callstack.");
            break;
        }
        printk("Expected callstack entry: %s\n", expectedCallStack[i]);
        zassert_not_null(
            actualCallstack[i],
            "Actual callstack is missing a call with the name %s.",
            expectedCallStack[i]);

        // If we get here both callstacks are non-null, safe to compare the strings
        zassert_equal(strcmp(actualCallstack[i], expectedCallStack[i]), 0, "Expected call of %s was not equal to the actual call of %s at index %u.", expectedCallStack[i], actualCallstack[i], i);
    }
}

void checkCurrentState(TestSm * sm, const char * expectedStateName)
{
    State * currentState = sm->currentState();
    zassert_equal(
        strcmp(currentState->name, expectedStateName),
        0,
        "Current state name \"%s\" did not match the expected state name of \"%s\".",
        currentState->name,
        expectedStateName);
}

ZTEST(framework_tests, make_sure_transitions_works)
{
    StateMachineController smc;
    
    // Create test SM
    auto testSm = TestSm(smThreadStack, smThreadFnAdapter, &smc);
    l_testSm = &testSm;

    testSm.start();

    // Give the state machine time to run
    k_msleep(1000);

    // Make sure we are in state 1
    checkCurrentState(&testSm, "State1");

    // Check the call stack
    std::array<const char *, CALL_STACK_DEPTH> expectedCallStack = {
        "Root_Entry",
        "State1_Entry",
     };
    checkCallstack(&testSm, expectedCallStack);

    // Fire event which will cause transition from state 1 to state 2
    TestEvent1 testEvent1;
    testSm.sendEvent(&testEvent1, sizeof(testEvent1));

    // Give the state machine time to run
    k_msleep(1000);

    // Make sure we are now in state 2
    checkCurrentState(&testSm, "State2");

    // Check the call stack
    expectedCallStack = {
        "State1_Event",
        "State1_Exit",
        "State2_Entry",
     };
    checkCallstack(&testSm, expectedCallStack);

    // Fire event which is not handled by any states, we should see
    // the state 2 and root state event handlers called
    RootEvent rootEvent;
    testSm.sendEvent(&rootEvent, sizeof(rootEvent));

    // Give the state machine time to run
    k_msleep(1000);

    // Make sure we are still in state 2
    checkCurrentState(&testSm, "State2");

    // Make sure the state 2 and root state event handlers were called
    expectedCallStack = {
        "State2_Event",
        "Root_Event",
     };
    checkCallstack(&testSm, expectedCallStack);

    // Goto state 2A
    GotoState2AEvent gotoState2AEvent;
    testSm.sendEvent(&gotoState2AEvent, sizeof(gotoState2AEvent));

    // Give the state machine time to run
    k_msleep(1000);

    // Make sure we are now in state 2A
    checkCurrentState(&testSm, "State2A");

    // Check the call stack
    expectedCallStack = {
        "State2_Event",
        "Root_Event",
        "State2A_Entry",
     };
    checkCallstack(&testSm, expectedCallStack);

    // Tell SM to goto state 2A again. Since we are already there, no transitions should occur
    testSm.sendEvent(&gotoState2AEvent, sizeof(gotoState2AEvent));

    // Give the state machine time to run
    k_msleep(1000);

    // Make sure we are still in state 2A
    checkCurrentState(&testSm, "State2A");

    // Check the call stack
    expectedCallStack = {
        "State2A_Event",
        "State2_Event",
        "Root_Event",
     };
    checkCallstack(&testSm, expectedCallStack);

    // Go to state root2, which is not connected to any other states
    GotoStateRoot2Event gotoStateRoot2Event;
    testSm.sendEvent(&gotoStateRoot2Event, sizeof(gotoStateRoot2Event));

    // Give the state machine time to run
    k_msleep(1000);

    // Make sure we are now in state root2
    checkCurrentState(&testSm, "Root2");

    // Check the call stack
    expectedCallStack = {
        "State2A_Event",
        "State2_Event",
        "Root_Event",
        "State2A_Exit",
        "State2_Exit",
        "Root_Exit", // We leave the root state
        "Root2_Entry",
     };
    checkCallstack(&testSm, expectedCallStack);

    testSm.terminateThread();
    testSm.join();
}
```

## src/TestSm.cpp
```c
#include <cstdio>

#include <zephyr/logging/log.h>

#include "TestSm.h"

LOG_MODULE_REGISTER(TestSm, LOG_LEVEL_DBG);

const uint8_t MAX_NUM_STATES = 10;

TestSm::TestSm(
    z_thread_stack_element * threadStack,
    void (*threadFnAdapter)(void *, void *, void *),
    StateMachineController * smc) :
        StateMachine(MAX_NUM_STATES, threadStack, 1024, threadFnAdapter, smc, "TestSm"),
        root(
            std::bind(&TestSm::Root_Entry, this),
            std::bind(&TestSm::Root_Event, this, std::placeholders::_1),
            std::bind(&TestSm::Root_Exit, this),
            nullptr, "Root"),
        state1(
            std::bind(&TestSm::State1_Entry, this),
            std::bind(&TestSm::State1_Event, this, std::placeholders::_1),
            std::bind(&TestSm::State1_Exit, this),
            &root, "State1"),
        state2(
            std::bind(&TestSm::State2_Entry, this),
            std::bind(&TestSm::State2_Event, this, std::placeholders::_1),
            std::bind(&TestSm::State2_Exit, this),
            &root, "State2"),
        state2A(
            std::bind(&TestSm::State2A_Entry, this),
            std::bind(&TestSm::State2A_Event, this, std::placeholders::_1),
            std::bind(&TestSm::State2A_Exit, this),
            &state2, "State2A"),
        root2(
            std::bind(&TestSm::Root2_Entry, this),
            std::bind(&TestSm::Root2_Event, this, std::placeholders::_1),
            std::bind(&TestSm::Root2_Exit, this),
            nullptr, "Root2")
    {
    LOG_INF("Test SM created.");


    addState(&root);
    addState(&state1);
    addState(&state2);
    addState(&state2A);
    addState(&root2);
    registerTimer(&timer);

    // Setup initial transition
    setInitialTransition(&state1);
}

void TestSm::addToCallstack(const char * functionName) {
    callstack[callstackIdx++] = functionName;
}

std::array<const char *, CALL_STACK_DEPTH> TestSm::getCallstackAndClear() {
    // Lock mutex
    k_mutex_lock(&mutex, K_FOREVER);
    // Copy callstack
    std::array<const char *, CALL_STACK_DEPTH> callstackCopy = callstack;
    // Clear callstack and index
    callstack.fill(nullptr);
    callstackIdx = 0;
    // Unlock mutex
    k_mutex_unlock(&mutex);
    return callstackCopy;
}

//============================================================
// STATE: Root
//============================================================

void TestSm::Root_Entry() {
    LOG_INF("%s called", __PRETTY_FUNCTION__);
    addToCallstack("Root_Entry");
}

void TestSm::Root_Event(Event * event) {
    LOG_INF("%s called. event.id: %u.", __PRETTY_FUNCTION__, event->id);
    addToCallstack("Root_Event");

    // Listen for GOTO_STATE_2A event
    if (event->id == (uint8_t)EventId::value<GotoState2AEvent>()) {
        queueTransition(&state2A);
    }

    // Listen for GOTO_STATE_ROOT2 event
    if (event->id == (uint8_t)EventId::value<GotoStateRoot2Event>()) {
        queueTransition(&root2);
    }
}

void TestSm::Root_Exit() {
    LOG_INF("%s called", __PRETTY_FUNCTION__);
    addToCallstack("Root_Exit");
}

//============================================================
// STATE: Root/State1
//============================================================

void TestSm::State1_Entry() {
    LOG_INF("%s called", __PRETTY_FUNCTION__);
    addToCallstack("State1_Entry");
}

void TestSm::State1_Event(Event * event) {
    LOG_INF("%s called. event.id: %u.", __PRETTY_FUNCTION__, event->id);
    addToCallstack("State1_Event");
    if (event->id == (uint8_t)EventId::value<TestEvent1>()) {
        queueTransition(&state2);
    }
}

void TestSm::State1_Exit() {
    LOG_INF("%s called", __PRETTY_FUNCTION__);
    addToCallstack("State1_Exit");
}

//============================================================
// STATE: Root/State2
//============================================================

void TestSm::State2_Entry() {
    LOG_INF("%s called", __PRETTY_FUNCTION__);
    addToCallstack("State2_Entry");
}

void TestSm::State2_Event(Event * event) {
    LOG_INF("%s called. event.id: %u.", __PRETTY_FUNCTION__, event->id);
    addToCallstack("State2_Event");
}

void TestSm::State2_Exit() {
    LOG_INF("%s called", __PRETTY_FUNCTION__);
    addToCallstack("State2_Exit");
}

//============================================================
// STATE: Root/State2/State2A
//============================================================

void TestSm::State2A_Entry() {
    LOG_INF("%s called", __PRETTY_FUNCTION__);
    addToCallstack("State2A_Entry");
}

void TestSm::State2A_Event(Event * event) {
    LOG_INF("%s called. event.id: %u.", __PRETTY_FUNCTION__, event->id);
    addToCallstack("State2A_Event");
    if (event->id == (uint8_t)EventId::value<StopPropagationEvent>()) {
        stopPropagation();
    }
}

void TestSm::State2A_Exit() {
    LOG_INF("%s called", __PRETTY_FUNCTION__);
    addToCallstack("State2A_Exit");
}

//============================================================
// STATE: Root2
//============================================================

void TestSm::Root2_Entry() {
    LOG_INF("%s called", __PRETTY_FUNCTION__);
    addToCallstack("Root2_Entry");
}

void TestSm::Root2_Event(Event * event) {
    LOG_INF("%s called. event.id: %u.", __PRETTY_FUNCTION__, event->id);
    addToCallstack("Root2_Event");
}

void TestSm::Root2_Exit() {
    LOG_INF("%s called", __PRETTY_FUNCTION__);
    addToCallstack("Root2_Exit");
}
```

## src/TestSm.h
```c
#pragma once

#include <cstring>

#include <zephyr/kernel.h>

#include "StateMachineLibrary/StateMachine.hpp"

const uint8_t CALL_STACK_DEPTH = 10;

//================================================================================================//
// PUBLIC EVENTS
//================================================================================================//

class TestEvent1 : public Event {
    public:
        TestEvent1() : Event((uint8_t)EventId::value<TestEvent1>(), "TestSm::TestEvent1") {}
};

class RootEvent : public Event {
    public:
        RootEvent() : Event((uint8_t)EventId::value<RootEvent>(), "TestSm::RootEvent") {}
};

class GotoState2AEvent : public Event {
    public:
        GotoState2AEvent() : Event((uint8_t)EventId::value<GotoState2AEvent>(), "TestSm::GotoState2AEvent") {}
};

class GotoStateRoot2Event : public Event {
    public:
        GotoStateRoot2Event() : Event((uint8_t)EventId::value<GotoStateRoot2Event>(), "TestSm::GotoStateRoot2Event") {}
};

//================================================================================================//
// STATE MACHINE PROTOTYPE
//================================================================================================//

class TestSm : public StateMachine {
    public:
        TestSm(
            z_thread_stack_element * threadStack, 
            void (*threadFnAdapter)(void *, void *, void *),
            StateMachineController * smc);

        void turnOn();

        std::array<const char *, CALL_STACK_DEPTH> callstack = { nullptr };

        void addToCallstack(const char * functionName);

        std::array<const char *, CALL_STACK_DEPTH> getCallstackAndClear();

    private:

        uint8_t callstackIdx = 0;

        State root;
        void Root_Entry();
        void Root_Event(Event * event);
        void Root_Exit();

        State state1;
        void State1_Entry();
        void State1_Event(Event * event);
        void State1_Exit();

        State state2;
        void State2_Entry();
        void State2_Event(Event * event);
        void State2_Exit();

        State state2A;
        void State2A_Entry();
        void State2A_Event(Event * event);
        void State2A_Exit();

        State root2;
        void Root2_Entry();
        void Root2_Event(Event * event);
        void Root2_Exit();

        Timer timer;
};
```
